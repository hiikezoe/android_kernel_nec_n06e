## drivers/char/diag_w/Kconfig
```kconfig
#/***********************************************************************/
#/* Modified by                                                         */
#/* (C) NEC CASIO Mobile Communications, Ltd. 2013                      */
#/***********************************************************************/

menu "Diag Wrapper Support"

config DIAG_W
	tristate "char driver interface and diag forwarding to/from ARM9"
	default y
	help
	 Char driver interface for diag user space and diag-forwarding to modem ARM and back.
endmenu

menu "Key Diag Wrapper Support"

config KEY_DIAG_W
	tristate "char driver interface and diag forwarding to/from ARM9"
	default y
	help
	 Char driver interface for diag user space and diag-forwarding to modem ARM and back.
endmenu

menu "Touchpanel Diag Wrapper Support"

config TOUCHPANEL_DIAG_W
	tristate "char driver interface and diag forwarding to/from ARM9"
	default y
	help
	 Char driver interface for diag user space and diag-forwarding to modem ARM and back.
endmenu
```

## drivers/i2c/chips/Kconfig
```kconfig
#
# Miscellaneous I2C chip drivers configuration
#
# *** DEPRECATED! Do not add new entries! See Makefile ***
#
#/***********************************************************************/
#/* Modified by                                                         */
#/* (C) NEC CASIO Mobile Communications, Ltd. 2013                      */
#/***********************************************************************/

menu "Miscellaneous I2C Chip support"


config SENSORS_AKM8977
	tristate "AKM8977 Compass Driver"
	depends on I2C
	default y
	help
	  If you say yes here you get support for Asahi Kasei's 
	  orientation sensor AK8977.

config SENSORS_COMMON
	tristate "Common Sensors Driver"
	depends on I2C
	default y
	help
	 Common Sensors Driver.









config SENSORS_APDS990X
	tristate "APDS990X Digital Proximity and Ambient Light Sensor Driver"
	depends on I2C
	default y
	help
	  If you say Y here, support for the APDS990X Digital Proximity and Ambient
	  Light Sensor Driver will be compiled into the kernel and accessible via a
	  device node. You can also say M here and the driver will be built as a
	  module named apds990x.ko.













































endmenu
```

## drivers/video/msm/mhl/Kconfig
```kconfig
#/***********************************************************************/
#/* Modified by                                                         */
#/* (C) NEC CASIO Mobile Communications, Ltd. 2013                      */
#/***********************************************************************/


config FEATURE_DVE021_MHL
    bool "Sili8334 MHL Transmitter"
    default n
    ---help---
         Support for SiI8334 MHL Transmitter
```
